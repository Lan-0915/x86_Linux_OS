
/** 
 *	链接脚本（Linker Script），用于控制程序在内存中的布局（即如何将编译生成的各个段 —— 如代码段、数据段 —— 映射到内存地址）
 *	主要用于自制操作系统的用户态程序（如 init 程序），明确指定程序加载到内存的起始地址和各段的排列方式
 */

ENTRY(_start)
SECTIONS
{
	. = 0x82000000;		/* . 是链接器的 “位置计数器”，表示当前内存地址. 作用是将位置计数器设置为 0x82000000，即整个程序的加载起始地址为 0x82000000 */
	.text : {			/* .text 是代码段，存放程序的可执行指令（如函数、汇编指令）*/
		*(*.text)
	}

	.rodata : {			/* .rodata 是只读数据段，存放常量（如 const int a = 10、字符串字面量 "hello"） */
		*(*.rodata)
	}

	.data : {			/* .data 是数据段，存放已初始化的全局变量和静态变量（如 int b = 20） */
		*(*.data)
	}

	.bss : {			/* .bss 是未初始化数据段，存放未初始化的全局变量和静态变量（如 int c; static int d;） */
		__bss_start__ = .;
		*(*.bss)
    	__bss_end__ = . ;
	}
}
